## components/espscreen_apps/Kconfig
```kconfig
menu "EspScreenOS applications"
config ESPSCREEN_SD_APPS
 bool "Lua applications sideloaded from /sd/apps"
 default y
config ESPSCREEN_APP_DASHBOARD
 bool "Dashboard"
 default y
config ESPSCREEN_APP_HARDWARE_TEST
 bool "Hardware test"
 default y
config ESPSCREEN_APP_BOARD_INFO
 bool "Board information"
 default y
config ESPSCREEN_APP_CALCULATOR
 bool "Calculator"
 default y
config ESPSCREEN_APP_GPIO_TOOLBOX
 bool "GPIO toolbox"
 default y
config ESPSCREEN_APP_RECORDER
 bool "Sound recorder/player"
 default y
config ESPSCREEN_APP_PAINT
 bool "Paint"
 default y
config ESPSCREEN_APP_NOTES
 bool "Notes editor"
 default y
endmenu
```

## generated/hosyond-esp32-35-st7796u/sdkconfig.defaults
```kconfig
CONFIG_IDF_TARGET="esp32"
CONFIG_ESPTOOLPY_FLASHSIZE_4MB=y
CONFIG_PARTITION_TABLE_CUSTOM=y
CONFIG_PARTITION_TABLE_CUSTOM_FILENAME="generated/hosyond-esp32-35-st7796u/partitions.csv"
CONFIG_ESP_MAIN_TASK_STACK_SIZE=8192
CONFIG_ESP_DEFAULT_CPU_FREQ_MHZ_240=y
CONFIG_ESP_DEFAULT_CPU_FREQ_MHZ=240
CONFIG_COMPILER_OPTIMIZATION_PERF=y
CONFIG_FREERTOS_HZ=1000
CONFIG_ESP_TASK_WDT_TIMEOUT_S=15
# CONFIG_ESP_TASK_WDT_CHECK_IDLE_TASK_CPU0 is not set
CONFIG_LV_DEF_REFR_PERIOD=16
CONFIG_LV_FONT_MONTSERRAT_12=y
CONFIG_LV_FONT_MONTSERRAT_14=y
CONFIG_LV_FONT_MONTSERRAT_16=y
```

## generated/hosyond-esp32s3-35-st77922/sdkconfig.defaults
```kconfig
CONFIG_IDF_TARGET="esp32s3"
CONFIG_ESPTOOLPY_FLASHSIZE_16MB=y
CONFIG_PARTITION_TABLE_CUSTOM=y
CONFIG_PARTITION_TABLE_CUSTOM_FILENAME="generated/hosyond-esp32s3-35-st77922/partitions.csv"
CONFIG_ESP_MAIN_TASK_STACK_SIZE=8192
CONFIG_ESP_DEFAULT_CPU_FREQ_MHZ_240=y
CONFIG_ESP_DEFAULT_CPU_FREQ_MHZ=240
CONFIG_COMPILER_OPTIMIZATION_PERF=y
CONFIG_FREERTOS_HZ=1000
CONFIG_ESP_TASK_WDT_TIMEOUT_S=15
# CONFIG_ESP_TASK_WDT_CHECK_IDLE_TASK_CPU0 is not set
CONFIG_LV_DEF_REFR_PERIOD=16
CONFIG_LV_FONT_MONTSERRAT_12=y
CONFIG_LV_FONT_MONTSERRAT_14=y
CONFIG_LV_FONT_MONTSERRAT_16=y
CONFIG_SPIRAM=y
CONFIG_SPIRAM_MODE_OCT=y
CONFIG_SPIRAM_SPEED_80M=y
CONFIG_SPIRAM_SPEED=80
```
