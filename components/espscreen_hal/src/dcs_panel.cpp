#include "dcs_panel.hpp"
#include "driver/gpio.h"
#include "esp_check.h"
#include "esp_lcd_panel_interface.h"
#include "esp_log.h"
#include "freertos/FreeRTOS.h"
#include "freertos/task.h"
#include <cstdlib>
#include <cstring>
#include <array>

namespace espscreen::hal::detail {
namespace {
constexpr const char* TAG="dcs_panel";
constexpr int SWRESET=0x01, SLPOUT=0x11, NORON=0x13, INVOFF=0x20, INVON=0x21, DISPOFF=0x28, DISPON=0x29;
constexpr int CASET=0x2A, RASET=0x2B, RAMWR=0x2C, MADCTL=0x36, COLMOD=0x3A;
struct Panel { esp_lcd_panel_t base{}; esp_lcd_panel_io_handle_t io{}; board::DisplayConfig cfg{}; int x_gap{0}; int y_gap{0}; bool swap{false}; bool mx{false}; bool my{false}; };
struct InitCommand { std::uint8_t command; std::array<std::uint8_t,16> data; std::uint8_t length; std::uint16_t delay_ms; };
constexpr InitCommand es3c35p_init[] = {
 {0xF1,{0x00},1,0},{0x60,{0x00,0x00,0x00},3,0},{0x65,{0x80},1,0},{0x79,{0x06},1,0},{0x7B,{0x00,0x08,0x08},3,0},
 {0x80,{0x55,0x62,0x2F,0x17,0xF0,0x52,0x70,0xD2,0x52,0x62,0xEA},11,0},{0x81,{0x26,0x52,0x72,0x27},4,0},{0x84,{0x92,0x25},2,0},
 {0x87,{0x10,0x10,0x58,0x00,0x02,0x3A},6,0},{0x88,{0x00,0x00,0x2C,0x10,0x04,0x00,0x00,0x00,0x01,0x01,0x01,0x01,0x01,0x00,0x06},15,0},
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 {0xE3,{0x40,0x40},2,0},{0xF0,{0x00},1,0},{0xD0,{0x00},1,0},{0x2A,{0x00,0x00,0x01,0x3F},4,0},{0x2B,{0x00,0x00,0x01,0xDF},4,0},
 {0x21,{},0,0},{0x11,{},0,120},{0x29,{},0,0},{0x2C,{},0,0},{0x3A,{0x01},1,0},{0x36,{0x00},1,0},{0x35,{0x01},1,20},
};
inline Panel* self(esp_lcd_panel_t* p){return reinterpret_cast<Panel*>(p);} 
int command(const Panel* p,int cmd,bool color=false){
 if(p->cfg.bus!=board::BusKind::qspi) return cmd;
 return ((color?0x32:0x02)<<24)|(cmd<<8);
}
esp_err_t tx(Panel* p,int cmd,const void* data,size_t n){return esp_lcd_panel_io_tx_param(p->io,command(p,cmd),data,n);} 
esp_err_t del(esp_lcd_panel_t* base){auto* p=self(base); if(board::valid_pin(p->cfg.pins.reset)) gpio_reset_pin(static_cast<gpio_num_t>(p->cfg.pins.reset)); std::free(p); return ESP_OK;}
esp_err_t reset(esp_lcd_panel_t* base){auto* p=self(base); if(board::valid_pin(p->cfg.pins.reset)){gpio_set_level(static_cast<gpio_num_t>(p->cfg.pins.reset),0);vTaskDelay(pdMS_TO_TICKS(10));gpio_set_level(static_cast<gpio_num_t>(p->cfg.pins.reset),1);vTaskDelay(pdMS_TO_TICKS(120));}else{tx(p,SWRESET,nullptr,0);vTaskDelay(pdMS_TO_TICKS(120));}return ESP_OK;}
void common_init(Panel* p){const std::uint8_t format=0x55;tx(p,COLMOD,&format,1);const std::uint8_t mad= p->cfg.color_order==board::ColorOrder::bgr?0x08:0x00;tx(p,MADCTL,&mad,1);}
esp_err_t init(esp_lcd_panel_t* base){auto* p=self(base);
 if(p->cfg.driver==board::DisplayDriver::st77922){for(const auto& entry:es3c35p_init){ESP_RETURN_ON_ERROR(tx(p,entry.command,entry.length?entry.data.data():nullptr,entry.length),TAG,"ES3C35P init");if(entry.delay_ms)vTaskDelay(pdMS_TO_TICKS(entry.delay_ms));}return ESP_OK;}
 tx(p,SLPOUT,nullptr,0);vTaskDelay(pdMS_TO_TICKS(120));
 if(p->cfg.driver==board::DisplayDriver::st7796u||p->cfg.driver==board::DisplayDriver::st7796s){
  const std::uint8_t f0a[]={0xC3};tx(p,0xF0,f0a,1);const std::uint8_t f0b[]={0x96};tx(p,0xF0,f0b,1);
  const std::uint8_t b4[]={0x01};tx(p,0xB4,b4,1);const std::uint8_t b7[]={0xC6};tx(p,0xB7,b7,1);
  const std::uint8_t c1[]={0x06};tx(p,0xC1,c1,1);const std::uint8_t c2[]={0xA7};tx(p,0xC2,c2,1);
  const std::uint8_t c5[]={0x18};tx(p,0xC5,c5,1);
  const std::uint8_t e0[]={0xF0,0x09,0x0B,0x06,0x04,0x15,0x2F,0x54,0x42,0x3C,0x17,0x14,0x18,0x1B};tx(p,0xE0,e0,sizeof(e0));
  const std::uint8_t e1[]={0xE0,0x09,0x0B,0x06,0x04,0x03,0x2B,0x43,0x42,0x3B,0x16,0x14,0x17,0x1B};tx(p,0xE1,e1,sizeof(e1));
  const std::uint8_t f0c[]={0x3C};tx(p,0xF0,f0c,1);const std::uint8_t f0d[]={0x69};tx(p,0xF0,f0d,1);
 }
 common_init(p);tx(p,p->cfg.invert?INVON:INVOFF,nullptr,0);tx(p,NORON,nullptr,0);vTaskDelay(pdMS_TO_TICKS(10));tx(p,DISPON,nullptr,0);vTaskDelay(pdMS_TO_TICKS(20));return ESP_OK;}
esp_err_t draw(esp_lcd_panel_t* base,int xs,int ys,int xe,int ye,const void* colors){auto* p=self(base);xs+=p->x_gap;xe+=p->x_gap;ys+=p->y_gap;ye+=p->y_gap;
 std::uint8_t col[]={static_cast<std::uint8_t>(xs>>8),static_cast<std::uint8_t>(xs),static_cast<std::uint8_t>((xe-1)>>8),static_cast<std::uint8_t>(xe-1)};
 std::uint8_t row[]={static_cast<std::uint8_t>(ys>>8),static_cast<std::uint8_t>(ys),static_cast<std::uint8_t>((ye-1)>>8),static_cast<std::uint8_t>(ye-1)};
 ESP_RETURN_ON_ERROR(tx(p,CASET,col,4),TAG,"column");ESP_RETURN_ON_ERROR(tx(p,RASET,row,4),TAG,"row");
 return esp_lcd_panel_io_tx_color(p->io,command(p,RAMWR,true),colors,(xe-xs)*(ye-ys)*2);
}
esp_err_t invert(esp_lcd_panel_t* base,bool value){auto* p=self(base);return tx(p,value?INVON:INVOFF,nullptr,0);} 
esp_err_t gap(esp_lcd_panel_t* base,int x,int y){auto* p=self(base);p->x_gap=x;p->y_gap=y;return ESP_OK;}
esp_err_t mirror(esp_lcd_panel_t* base,bool mx,bool my){auto* p=self(base);p->mx=mx;p->my=my;std::uint8_t v=(mx?0x40:0)|(my?0x80:0)|(p->swap?0x20:0)|(p->cfg.color_order==board::ColorOrder::bgr?0x08:0);return tx(p,MADCTL,&v,1);} 
esp_err_t swap_xy(esp_lcd_panel_t* base,bool swap){auto* p=self(base);p->swap=swap;return mirror(base,p->mx,p->my);} 
esp_err_t onoff(esp_lcd_panel_t* base,bool on){auto* p=self(base);return tx(p,on?DISPON:DISPOFF,nullptr,0);} 
}
esp_err_t new_dcs_panel(esp_lcd_panel_io_handle_t io,const board::DisplayConfig& cfg,esp_lcd_panel_handle_t* output){
 ESP_RETURN_ON_FALSE(io&&output,ESP_ERR_INVALID_ARG,TAG,"invalid args");auto* p=static_cast<Panel*>(std::calloc(1,sizeof(Panel)));ESP_RETURN_ON_FALSE(p,ESP_ERR_NO_MEM,TAG,"alloc");p->io=io;p->cfg=cfg;
 p->base.del=del;p->base.reset=reset;p->base.init=init;p->base.draw_bitmap=draw;p->base.invert_color=invert;p->base.set_gap=gap;p->base.mirror=mirror;p->base.swap_xy=swap_xy;p->base.disp_on_off=onoff;
 if(board::valid_pin(cfg.pins.reset)){gpio_config_t c{};c.mode=GPIO_MODE_OUTPUT;c.pin_bit_mask=1ULL<<cfg.pins.reset;gpio_config(&c);gpio_set_level(static_cast<gpio_num_t>(cfg.pins.reset),1);}*output=&p->base;return ESP_OK;
}
}
